## Documentation/devicetree/bindings/display/panel/rabbit,r1-panel.yaml
```yaml
# SPDX-License-Identifier: (GPL-2.0-only OR BSD-2-Clause)
%YAML 1.2
---
$id: http://devicetree.org/schemas/display/panel/rabbit,r1-panel.yaml#
$schema: http://devicetree.org/meta-schemas/core.yaml#

title: rabbit r1 480x640 MIPI DSI panel

maintainers:
  - itskenny0 <0@kenny.cat>

description: |
  The rabbit r1 uses a two-lane RGB888 panel. This experimental binding
  identifies the panel by the board, because the vendor driver name and
  its active command sequence disagree about the controller model.
  The driver currently relies on firmware-established panel power. Supply
  routing and cold power-on sequencing have not been established.

allOf:
  - $ref: panel-common.yaml#

properties:
  compatible:
    const: rabbit,r1-panel

  reg:
    maxItems: 1

  reset-gpios: true
  backlight: true
  port: true

required:
  - compatible
  - reg
  - reset-gpios
  - backlight
  - port

unevaluatedProperties: false

examples:
  - |
    #include <dt-bindings/gpio/gpio.h>

    dsi {
        #address-cells = <1>;
        #size-cells = <0>;

        panel@0 {
            compatible = "rabbit,r1-panel";
            reg = <0>;
            reset-gpios = <&pio 45 GPIO_ACTIVE_LOW>;
            backlight = <&backlight>;

            port {
                panel_in: endpoint {
                    remote-endpoint = <&dsi_out>;
                };
            };
        };
    };
```

## Documentation/devicetree/bindings/input/touchscreen/hynitron,cst836.yaml
```yaml
# SPDX-License-Identifier: (GPL-2.0-only OR BSD-2-Clause)
%YAML 1.2
---
$id: http://devicetree.org/schemas/input/touchscreen/hynitron,cst836.yaml#
$schema: http://devicetree.org/meta-schemas/core.yaml#

title: Hynitron CST836 touchscreen controller

maintainers:
  - itskenny0 <0@kenny.cat>

description:
  Self-capacitance controller with two contacts and an 8-bit register address.
  The CST328 mutual-capacitance protocol is not compatible with this binding.

allOf:
  - $ref: touchscreen.yaml#

properties:
  compatible:
    const: hynitron,cst836

  reg:
    maxItems: 1

  interrupts:
    maxItems: 1

  reset-gpios:
    maxItems: 1
    description: Active-low reset line.

  touchscreen-size-x:
    minimum: 1
    maximum: 4096

  touchscreen-size-y:
    minimum: 1
    maximum: 4096

required:
  - compatible
  - reg
  - interrupts
  - reset-gpios
  - touchscreen-size-x
  - touchscreen-size-y

unevaluatedProperties: false

examples:
  - |
    #include <dt-bindings/gpio/gpio.h>
    #include <dt-bindings/interrupt-controller/irq.h>
    i2c {
        #address-cells = <1>;
        #size-cells = <0>;

        touchscreen@15 {
            compatible = "hynitron,cst836";
            reg = <0x15>;
            interrupt-parent = <&gpio>;
            interrupts = <0 IRQ_TYPE_EDGE_FALLING>;
            reset-gpios = <&gpio 174 GPIO_ACTIVE_LOW>;
            touchscreen-size-x = <480>;
            touchscreen-size-y = <640>;
        };
    };
```

## Documentation/devicetree/bindings/power/supply/mediatek,mt6357-gauge.yaml
```yaml
# SPDX-License-Identifier: (GPL-2.0-only OR BSD-2-Clause)
%YAML 1.2
---
$id: http://devicetree.org/schemas/power/supply/mediatek,mt6357-gauge.yaml#
$schema: http://devicetree.org/meta-schemas/core.yaml#

title: MediaTek MT6357 battery gauge

maintainers:
  - itskenny0 <0@kenny.cat>

description:
  Battery measurements in the MT6357 PMIC. The gauge is a child of the PMIC
  MFD and uses its regmap. Positive current means charging. Optional voltage
  inputs provide battery voltage and an NTC thermistor measurement. Both the
  thermistor and its measured pull-up reference are corrected for the voltage
  drop across the specified return-path resistance, using gauge current.
  Current measurements use the firmware-initialized gauge engine; this binding
  does not establish support for capacity estimation or charging policy.

allOf:
  - $ref: power-supply.yaml#
  - if:
      required:
        - io-channels
    then:
      required:
        - io-channel-names
        - mediatek,thermistor-pullup-ohms
        - mediatek,thermistor-series-micro-ohms
        - mediatek,thermistor-resistance-table

properties:
  compatible:
    const: mediatek,mt6357-gauge

  shunt-resistor-micro-ohms:
    description: Battery current sense resistor resistance in microohms.
    minimum: 1

  mediatek,current-gain-permille:
    $ref: /schemas/types.yaml#/definitions/uint32
    description:
      Board current calibration multiplier, in parts per thousand. A value
      of 1000 leaves the shunt-corrected reading unchanged. This is the
      applied gain, not the stock firmware's CAR_TUNE_VALUE percentage.
    minimum: 1
    default: 1000

  io-channels:
    items:
      - description: Battery voltage
      - description: Thermistor voltage
      - description: Thermistor pull-up reference voltage

  io-channel-names:
    items:
      - const: battery-voltage
      - const: battery-thermistor
      - const: thermistor-reference

  mediatek,thermistor-pullup-ohms:
    description: Resistance of the thermistor pull-up resistor.
    minimum: 1

  mediatek,thermistor-series-micro-ohms:
    description:
      Total resistance of the battery current return path whose voltage drop
      appears in both thermistor and reference measurements. Zero disables
      compensation. This need not equal the current sense resistor alone.

  mediatek,thermistor-resistance-table:
    $ref: /schemas/types.yaml#/definitions/int32-matrix
    description:
      NTC temperature and resistance pairs, ordered by strictly increasing
      temperature and strictly decreasing resistance. Interpolate linearly
      in resistance and clamp readings outside the table to its endpoints.
      This describes the thermistor, not the battery's internal resistance.
    minItems: 2
    maxItems: 64
    items:
      items:
        - description: Temperature in milliCelsius
        - description: Thermistor resistance in ohms
          minimum: 1

dependencies:
  io-channel-names: [io-channels]
  mediatek,thermistor-pullup-ohms: [io-channels]
  mediatek,thermistor-series-micro-ohms: [io-channels]
  mediatek,thermistor-resistance-table: [io-channels]

required:
  - compatible
  - shunt-resistor-micro-ohms

unevaluatedProperties: false

examples:
  - |
    pmic {
        gauge {
            compatible = "mediatek,mt6357-gauge";
            shunt-resistor-micro-ohms = <10000>;
            mediatek,current-gain-permille = <1000>;
        };
    };
```

## Documentation/devicetree/bindings/power/supply/rabbit,r1-charging-policy.yaml
```yaml
# SPDX-License-Identifier: (GPL-2.0-only OR BSD-2-Clause)
%YAML 1.2
---
$id: http://devicetree.org/schemas/power/supply/rabbit,r1-charging-policy.yaml#
$schema: http://devicetree.org/meta-schemas/core.yaml#

title: Rabbit r1 charging policy

maintainers:
  - itskenny0 <0@kenny.cat>

description: |
  Board policy for the MT6357 gauge and MT6370 charger. Combines a user cap,
  battery measurements, charger protection and USB budgets. The charger must
  enable richtek,managed-charging. The optional Type-C supply must report
  sink ONLINE, USB_TYPE, CURRENT_MAX and VOLTAGE_NOW. The gadget supply is a
  constraint for SDP enumeration and suspend, not evidence of cable attachment.

properties:
  compatible:
    const: rabbit,r1-charging-policy

  charger-supply:
    description: MT6370 charger with managed charging enabled.

  battery-supply:
    description: Gauge providing presence, current, voltage and temperature.

  usb-gadget-supply:
    description: MediaTek USB gadget current-budget supply.

  typec-supply:
    description: Optional TCPM sink power-budget supply.

required:
  - compatible
  - charger-supply
  - battery-supply
  - usb-gadget-supply

additionalProperties: false
```
